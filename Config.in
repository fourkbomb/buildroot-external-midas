## board/midas/kernel.its
```
/dts-v1/;

/ {
    description = "Galaxy S III / Galaxy Note 2 boot image";

    images {
        kernel {
            description = "kernel";
            data = /incbin/("./zImage");
            type = "kernel";
            arch = "arm";
            os = "linux";
            compression = "none";
            load = <0x40000000>;
            entry = <0x40000000>;
            hash-1 {
                algo = "md5";
            };
            hash-2 {
                algo = "sha1";
            };
        };

        fdt-i9300 {
            description = "exynos4412-i9300.dtb";
            data = /incbin/("./exynos4412-i9300.dtb");
            type = "flat_dt";
            arch = "arm";
            compression = "none";
            load = <0x60000000>;
            hash-1 {
                algo = "crc32";
            };
        };

        fdt-i9305 {
            description = "exynos4412-i9305.dtb";
            data = /incbin/("./exynos4412-i9305.dtb");
            type = "flat_dt";
            arch = "arm";
            compression = "none";
            load = <0x60000000>;
            hash-1 {
                algo = "crc32";
            };
        };

        fdt-n7100 {
            description = "exynos4412-n7100.dtb";
            data = /incbin/("./exynos4412-n7100.dtb");
            type = "flat_dt";
            arch = "arm";
            compression = "none";
            load = <0x60000000>;
            hash-1 {
                algo = "crc32";
            };
        };

        fdt-n7105 {
            description = "exynos4412-n7105.dtb";
            data = /incbin/("./exynos4412-n7105.dtb");
            type = "flat_dt";
            arch = "arm";
            compression = "none";
            load = <0x60000000>;
            hash-1 {
                algo = "crc32";
            };
        };

        dto-ea8061 {
            description = "exynos4412-n710x-ea8061.dtbo";
            data = /incbin/("./exynos4412-n710x-ea8061.dtb");
            type = "flat_dt";
            arch = "arm";
            compression = "none";
            load = <0x6fc00000>;
            hash-1 {
                algo = "crc32";
            };
        };

        dto-s6evr02 {
            description = "exynos4412-n710x-s6evr02.dtbo";
            data = /incbin/("./exynos4412-n710x-s6evr02.dtb");
            type = "flat_dt";
            arch = "arm";
            compression = "none";
            load = <0x6fc00000>;
            hash-1 {
                algo = "crc32";
            };
        };

        ramdisk {
            description = "buildroot ramdisk";
            data = /incbin/("./rootfs.cpio.lzma");
            type = "ramdisk";
            arch = "arm";
            os = "linux";
            compression = "lzma";
            hash-1 {
                algo = "crc32";
            };
        };
    };

    configurations {
        exynos4412-i9300 {
            description = "exynos4412-i9300";
            kernel = "kernel";
            fdt = "fdt-i9300";
            ramdisk = "ramdisk";
        };

        exynos4412-i9305 {
            description = "exynos4412-i9305";
            kernel = "kernel";
            fdt = "fdt-i9305";
            ramdisk = "ramdisk";
        };

        exynos4412-n7100 {
            description = "exynos4412-n7100";
            kernel = "kernel";
            fdt = "fdt-n7100";
            ramdisk = "ramdisk";
        };

        exynos4412-n7105 {
            description = "exynos4412-n7105";
            kernel = "kernel";
            fdt = "fdt-n7105";
            ramdisk = "ramdisk";
        };

        note2-ea8061 {
            fdt = "dto-ea8061";
        };

        note2-s6evr02 {
            fdt = "dto-s6evr02";
        };
    };
};
```

## configs/samsung_midas_defconfig
```kconfig
BR2_arm=y
BR2_cortex_a9=y
BR2_ARM_ENABLE_NEON=y
BR2_ARM_ENABLE_VFP=y
BR2_CCACHE=y
BR2_CCACHE_DIR="/mnt/android/buildroot/.ccache"
BR2_CCACHE_INITIAL_SETUP="--max-size 10G"
BR2_TOOLCHAIN_BUILDROOT_GLIBC=y
BR2_KERNEL_HEADERS_4_17=y
BR2_BINUTILS_VERSION_2_30_X=y
BR2_GCC_VERSION_8_X=y
BR2_TOOLCHAIN_BUILDROOT_CXX=y
BR2_TARGET_GENERIC_HOSTNAME="midas"
BR2_TARGET_GENERIC_ROOT_PASSWD="root"
# BR2_TARGET_GENERIC_GETTY is not set
BR2_ROOTFS_OVERLAY="$(BR2_EXTERNAL_MIDAS_PATH)/board/midas/rootfs-overlay/"
BR2_ROOTFS_POST_IMAGE_SCRIPT="$(BR2_EXTERNAL_MIDAS_PATH)/board/midas/post-image.sh"
BR2_LINUX_KERNEL=y
BR2_LINUX_KERNEL_CUSTOM_GIT=y
BR2_LINUX_KERNEL_CUSTOM_REPO_URL="https://github.com/fourkbomb/linux"
BR2_LINUX_KERNEL_CUSTOM_REPO_VERSION="kexec"
BR2_LINUX_KERNEL_DEFCONFIG="midas"
BR2_LINUX_KERNEL_DTS_SUPPORT=y
BR2_LINUX_KERNEL_INTREE_DTS_NAME="exynos4412-i9300 exynos4412-i9305 exynos4412-n7100 exynos4412-n7105 overlay/exynos4412-n710x-ea8061 overlay/exynos4412-n710x-s6evr02"
BR2_PACKAGE_LINUX_TOOLS_GPIO=y
BR2_PACKAGE_BUSYBOX_SHOW_OTHERS=y
BR2_PACKAGE_ALSA_UTILS=y
BR2_PACKAGE_ALSA_UTILS_APLAY=y
BR2_PACKAGE_MPG123=y
BR2_PACKAGE_EVTEST=y
BR2_PACKAGE_I2C_TOOLS=y
BR2_PACKAGE_TINYALSA=y
BR2_PACKAGE_LIBARCHIVE=y
BR2_PACKAGE_LIBARCHIVE_BSDTAR=y
BR2_PACKAGE_DTC=y
BR2_PACKAGE_LIBNFC=y
BR2_PACKAGE_LIBNFC_EXAMPLES=y
BR2_PACKAGE_LIBV4L=y
BR2_PACKAGE_LIBV4L_UTILS=y
BR2_PACKAGE_BLUEZ5_UTILS=y
BR2_PACKAGE_BLUEZ5_UTILS_OBEX=y
BR2_PACKAGE_BLUEZ5_UTILS_CLIENT=y
BR2_PACKAGE_CRDA=y
BR2_PACKAGE_DHCPCD=y
BR2_PACKAGE_DNSMASQ=y
# BR2_PACKAGE_DNSMASQ_TFTP is not set
BR2_PACKAGE_IW=y
BR2_PACKAGE_NETCAT=y
BR2_PACKAGE_OPENSSH=y
BR2_PACKAGE_WPA_SUPPLICANT=y
BR2_PACKAGE_WPA_SUPPLICANT_AUTOSCAN=y
BR2_PACKAGE_WPA_SUPPLICANT_EAP=y
BR2_PACKAGE_WPA_SUPPLICANT_CLI=y
BR2_PACKAGE_MKSH=y
BR2_PACKAGE_UTIL_LINUX_BINARIES=y
BR2_TARGET_ROOTFS_CPIO=y
BR2_TARGET_ROOTFS_CPIO_LZMA=y
# BR2_TARGET_ROOTFS_TAR is not set
BR2_TARGET_UBOOT=y
BR2_TARGET_UBOOT_BUILD_SYSTEM_KCONFIG=y
BR2_TARGET_UBOOT_CUSTOM_GIT=y
BR2_TARGET_UBOOT_CUSTOM_REPO_URL="https://github.com/fourkbomb/u-boot"
BR2_TARGET_UBOOT_CUSTOM_REPO_VERSION="midas-2018.05"
BR2_TARGET_UBOOT_BOARD_DEFCONFIG="midas_defconfig"
BR2_TARGET_UBOOT_NEEDS_DTC=y
BR2_TARGET_UBOOT_SPL=y
BR2_TARGET_UBOOT_SPL_NAME="spl/midas-spl.bin"
BR2_PACKAGE_HOST_UBOOT_TOOLS=y
BR2_PACKAGE_HOST_UBOOT_TOOLS_FIT_SUPPORT=y
BR2_PACKAGE_MIDAS_UTIL=y
```

## package/midas-util/Config.in
```kconfig
config BR2_PACKAGE_MIDAS_UTIL
    bool "midas-util"
    depends on BR2_PACKAGE_DTC
    depends on BR2_PACKAGE_TINYALSA
    depends on BR2_PACKAGE_EXPAT
    help
        utilities for midas devices
```
